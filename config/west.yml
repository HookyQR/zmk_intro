## config/west.yml
```yaml
manifest:
  remotes:
    - name: zmkfirmware
      url-base: https://github.com/zmkfirmware
    - name: HookyQR
      url-base: https://github.com/HookyQR
  projects:
    - name: zmk
      remote: HookyQR
      revision: intro_debug
      import: app/west.yml
  self:
    path: config
```
